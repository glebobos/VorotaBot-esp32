## firmware/main/Kconfig.projbuild
```kconfig
menu "VorotaBot Device Configuration"

    menu "Wi-Fi & Captive Portal"
        config VOROTABOT_WIFI_SSID
            string "Default SoftAP SSID"
            default "VorotaBot-AP"
            help
                Default SSID broadcasted by the ESP32 SoftAP.

        config VOROTABOT_WIFI_PASSWORD
            string "Default SoftAP Password"
            default "12345678"
            help
                WPA2 password for SoftAP (empty for open network).

        config VOROTABOT_PORTAL_DOMAIN
            string "Captive Portal Domain"
            default "vorota.local"
            help
                Local domain name resolved by internal DNS server.
    endmenu

    menu "AWS Route 53"
        config VOROTABOT_ROOT_DOMAIN
            string "AWS Route 53 Root Domain"
            default "glebos.click"
            help
                Default root domain name for Route 53 dynamic DNS.

        config VOROTABOT_FQDN
            string "Default FQDN Hostname"
            default "vorota.glebos.click"
            help
                Default full hostname registered for the device.
    endmenu

endmenu
```

## firmware/sdkconfig.defaults
```kconfig
# Target Chip
CONFIG_IDF_TARGET="esp32c3"

# Serial Flasher
CONFIG_ESPTOOLPY_FLASHSIZE_4MB=y
CONFIG_ESPTOOLPY_FLASHSIZE="4MB"
CONFIG_ESPTOOLPY_FLASHMODE_DIO=y
CONFIG_ESPTOOLPY_FLASHFREQ_40M=y

# Custom Partition Table
CONFIG_PARTITION_TABLE_CUSTOM=y
CONFIG_PARTITION_TABLE_CUSTOM_FILENAME="partitions.csv"

# FreeRTOS Configuration
CONFIG_FREERTOS_HZ=1000
CONFIG_ESP_MAIN_TASK_STACK_SIZE=8192

# Bluetooth (NimBLE for lightweight RAM usage)
CONFIG_BT_ENABLED=y
CONFIG_BT_NIMBLE_ENABLED=y
CONFIG_BT_CONTROLLER_ONLY=n
CONFIG_BT_BLUEDROID_ENABLED=n

# Wi-Fi & LwIP Sockets
CONFIG_ESP_WIFI_SOFTAP_SUPPORT=y
CONFIG_LWIP_MAX_SOCKETS=16
CONFIG_LWIP_SO_REUSE=y
CONFIG_LWIP_SNTP_MAX_SERVERS=2

# HTTPS & mbedTLS for AWS Route 53 SigV4 client
CONFIG_MBEDTLS_CERTIFICATE_BUNDLE=y
CONFIG_MBEDTLS_CERTIFICATE_BUNDLE_DEFAULT_FULL=y

# HTTP Server
CONFIG_HTTPD_MAX_REQ_HDR_LEN=1024
CONFIG_HTTPD_MAX_URI_LEN=512
CONFIG_HTTPD_WS_SUPPORT=n

# SPIFFS
CONFIG_SPIFFS_USE_MAGIC=y
CONFIG_SPIFFS_USE_MAGIC_LENGTH=y

# Logging
CONFIG_LOG_DEFAULT_LEVEL_INFO=y

# Compiler Optimization for Performance
CONFIG_COMPILER_OPTIMIZATION_PERF=y

# lwIP & esp_netif compatibility with virtual/driver interfaces
CONFIG_ESP_NETIF_BRIDGE_EN=y
CONFIG_LWIP_NUM_NETIF_CLIENT_DATA=1
```
